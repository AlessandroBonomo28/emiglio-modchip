// =====================================================================
//  Emiglio modchip - PCBWay sponsor screen
//  Display TFT 128x160 ST7735S su CN1 (KF2510-8A) / ESP32-WROOM-32E
//
//  "Proud to announce a new sponsorship by PCBWay!"
//  High quality embedded board production -> https://www.pcbway.com/
//
//  Logo renderizzato come due bitmap 1bpp sovrapposte (wordmark verde +
//  swoosh arancione), 148x42, 798 byte ciascuna. Cosi' si usano i colori
//  reali del marchio con il drawBitmap() nativo di Adafruit_GFX, senza
//  sprecare 12 kB di bitmap RGB565.
//
//  ---------------------------------------------------------------------
//  MAPPATURA CN1 (KF2510-8A)
//   CN1-1 BLK -> +3V3 (LCD_SWITCH)   CN1-5 DC  -> GPIO4
//   CN1-2 SCL -> GPIO18              CN1-6 CS  -> GPIO15
//   CN1-3 SDA -> GPIO23              CN1-7 GND -> GND
//   CN1-4 RES -> GPIO2               CN1-8 VCC -> +3V3 (LCD_SWITCH)
// =====================================================================

#include <Arduino.h>
#include <SPI.h>
#include <Adafruit_GFX.h>
#include <Adafruit_ST7735.h>

// ---------------------------------------------------------------------
//  Pin e configurazione display
// ---------------------------------------------------------------------
#define PIN_TFT_SCLK   18
#define PIN_TFT_MOSI   23
#define PIN_TFT_RST     2
#define PIN_TFT_DC      4
#define PIN_TFT_CS     15

static constexpr uint16_t GRAM_W = 132;      // GRAM ST7735S (piu' grande del vetro)
static constexpr uint16_t GRAM_H = 162;
static constexpr int8_t   TFT_COLSTART = 2;  // offset tarati sul modulo
static constexpr int8_t   TFT_ROWSTART = 1;
static constexpr uint8_t  TFT_ROTATION = 1;  // landscape 160x128
static constexpr uint32_t TFT_SPI_HZ   = 40000000UL;

// ---------------------------------------------------------------------
//  Palette PCBWay (RGB565 calcolato a compile time)
// ---------------------------------------------------------------------
static constexpr uint16_t rgb565(uint8_t r, uint8_t g, uint8_t b)
{
    return (uint16_t)(((r & 0xF8) << 8) | ((g & 0xFC) << 3) | (b >> 3));
}
static constexpr uint16_t C_GREEN  = rgb565(0x22, 0x8B, 0x3C);   // verde marchio
static constexpr uint16_t C_ORANGE = rgb565(0xE0, 0x66, 0x1E);   // arancio swoosh
static constexpr uint16_t C_BG     = ST77XX_BLACK;
static constexpr uint16_t C_TXT    = ST77XX_WHITE;

// ---------------------------------------------------------------------
//  Il logo. Layer 1: wordmark "PCBWay". Layer 2: swoosh.
// ---------------------------------------------------------------------
static constexpr int16_t PCBWAY_W = 148;
static constexpr int16_t PCBWAY_H = 42;


static const uint8_t PCBWAY_GREEN[] PROGMEM = {
    0x1F, 0xFF, 0x80, 0x00, 0x04, 0x00, 0x7F, 0xFF, 0x83, 0xFC, 0x07, 0xF8,
    0x0F, 0xE0, 0x00, 0x00, 0x00, 0x00, 0x00, 0x1F, 0xFF, 0xF0, 0x00, 0xFF,
    0xC0, 0x7F, 0xFF, 0xE1, 0xFC, 0x07, 0xF8, 0x0F, 0xE0, 0x00, 0x00, 0x00,
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    0x00, 0x00, 0x00, 0x00, 0x00, 0x00
};

static const uint8_t PCBWAY_ORANGE[] PROGMEM = {
    0x00, 0x00, 0x00, 0x00, 0x00, 0x00, 0x00, 0x00, 0x00, 0x00, 0x00, 0x00,
    0x00, 0x00, 0x00, 0x00, 0x00, 0x00, 0x00, 0x00, 0x00, 0x00, 0x00, 0x00,
    0x00, 0x00, 0x00, 0x00, 0x00, 0x00, 0x00, 0x00, 0x00, 0x00, 0x00, 0x00,
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    0x00, 0x00, 0x00, 0x00, 0x00, 0x00
};

// ---------------------------------------------------------------------
//  Layout dello schermo (160x128)
// ---------------------------------------------------------------------
static constexpr int16_t LOGO_X   = (160 - PCBWAY_W) / 2;   // 6
static constexpr int16_t LOGO_Y   = 4;
static constexpr int16_t RULE_Y   = 50;
static constexpr int16_t LINE1_Y  = 56;    // NEW SPONSOR!
static constexpr int16_t LINE2_Y  = 68;    // high quality...
static constexpr int16_t LINE3_Y  = 78;
static constexpr int16_t LINE4_Y  = 90;    // url
static constexpr int16_t LINE5_Y  = 102;   // order here (lampeggia)
static constexpr int16_t MARQ_Y   = 116;   // striscia scorrevole
static constexpr int16_t MARQ_H   = 12;

// Il messaggio che scorre in basso, in loop infinito.
static const char MARQUEE_MSG[] =
    "*** PROUD TO ANNOUNCE A NEW SPONSORSHIP BY PCBWAY! *** "
    "HIGH QUALITY EMBEDDED BOARD PRODUCTION *** "
    "ORDER HERE: https://www.pcbway.com/ *** "
    "EMIGLIO LIVES AGAIN *** ";

// ---------------------------------------------------------------------
//  Display: sottoclasse per esporre setColRowStart() (protected)
// ---------------------------------------------------------------------
class Panel_ST7735 : public Adafruit_ST7735 {
public:
    Panel_ST7735(int8_t cs, int8_t dc, int8_t rst)
        : Adafruit_ST7735(cs, dc, rst) {}
    void applyOffsets(int8_t col, int8_t row) { setColRowStart(col, row); }
};

static Panel_ST7735 tft(PIN_TFT_CS, PIN_TFT_DC, PIN_TFT_RST);
static GFXcanvas1  marquee(160, MARQ_H);    // 240 byte, scroll senza flicker

// ---------------------------------------------------------------------
//  Helper: legge un bit dalle bitmap 1bpp (righe allineate al byte, MSB first)
// ---------------------------------------------------------------------
static inline bool bmpBit(const uint8_t *bmp, int16_t x, int16_t y)
{
    const int16_t bpr = (PCBWAY_W + 7) / 8;
    return (pgm_read_byte(&bmp[y * bpr + (x >> 3)]) >> (7 - (x & 7))) & 0x01;
}

static inline void drawWordmark(int16_t x, int16_t y)
{
    tft.drawBitmap(x, y, PCBWAY_GREEN, PCBWAY_W, PCBWAY_H, C_GREEN);
}
static inline void drawSwoosh(int16_t x, int16_t y)
{
    tft.drawBitmap(x, y, PCBWAY_ORANGE, PCBWAY_W, PCBWAY_H, C_ORANGE);
}

static void printCentered(int16_t y, uint8_t size, uint16_t fg, uint16_t bg,
                          const char *txt)
{
    const int16_t w = (int16_t)strlen(txt) * 6 * size;
    tft.setTextSize(size);
    tft.setTextColor(fg, bg);          // testo opaco: non serve cancellare
    tft.setCursor((160 - w) / 2, y);
    tft.print(txt);
}

// ---------------------------------------------------------------------
//  Init display (offset GRAM + wipe totale: zero pixel casuali ai bordi)
// ---------------------------------------------------------------------
static void lcdBegin()
{
    SPI.begin(PIN_TFT_SCLK, -1, PIN_TFT_MOSI, -1);

    tft.initR(INITR_BLACKTAB);
    tft.setSPISpeed(TFT_SPI_HZ);

    tft.startWrite();                             // azzera tutta la GRAM
    tft.setAddrWindow(0, 0, GRAM_W, GRAM_H);
    tft.writeColor(C_BG, (uint32_t)GRAM_W * (uint32_t)GRAM_H);
    tft.endWrite();

    tft.applyOffsets(TFT_COLSTART, TFT_ROWSTART);  // prima di setRotation()
    tft.setRotation(TFT_ROTATION);
    tft.fillScreen(C_BG);
    tft.setTextWrap(false);
}

// =====================================================================
//  INTRO
// =====================================================================

// 1) tre puntini di suspense
static void introTeaser()
{
    printCentered(58, 1, C_TXT, C_BG, "and the sponsor is");
    for (uint8_t i = 0; i < 3; ++i) {
        tft.fillCircle(66 + i * 14, 76, 3, C_ORANGE);
        delay(320);
    }
    delay(350);
    tft.fillScreen(C_BG);
}

// 2) il wordmark cade dall'alto e rimbalza
static void introDrop()
{
    float   y = -(float)PCBWAY_H;
    float   v = 0.0f;
    int16_t prev = (int16_t)y;

    for (uint16_t frame = 0; frame < 400; ++frame) {
        v += 1.35f;
        y += v;

        if (y >= (float)LOGO_Y) {                 // tocca terra
            y = (float)LOGO_Y;
            v = -v * 0.42f;                        // rimbalzo smorzato
            if (v > -2.0f) break;
        }

        const int16_t iy = (int16_t)y;
        if (iy != prev) {
            // cancella solo la striscia liberata: nessun flicker
            if (iy > prev)
                tft.fillRect(LOGO_X, prev, PCBWAY_W, iy - prev, C_BG);
            else
                tft.fillRect(LOGO_X, iy + PCBWAY_H, PCBWAY_W, prev - iy, C_BG);
            drawWordmark(LOGO_X, iy);
            prev = iy;
        }
        delay(10);
    }

    tft.fillRect(LOGO_X, 0, PCBWAY_W, PCBWAY_H + 8, C_BG);
    drawWordmark(LOGO_X, LOGO_Y);
    delay(120);
}

// 3) lo swoosh viene "routato" colonna per colonna, come una pista su PCB
static void introRouteSwoosh()
{
    for (int16_t x = 0; x < PCBWAY_W; ++x) {
        tft.startWrite();
        for (int16_t y = 0; y < PCBWAY_H; ++y)
            if (bmpBit(PCBWAY_ORANGE, x, y))
                tft.writePixel(LOGO_X + x, LOGO_Y + y, C_ORANGE);
        tft.endWrite();
        delay(5);
    }
    delay(150);
}

// 4) flash del titolo
static void introFlash()
{
    tft.drawFastHLine(0, RULE_Y, 160, C_ORANGE);
    for (uint8_t i = 0; i < 3; ++i) {
        printCentered(LINE1_Y, 1, C_ORANGE, C_BG, "NEW SPONSOR!");
        delay(160);
        printCentered(LINE1_Y, 1, C_BG, C_BG, "NEW SPONSOR!");
        delay(110);
    }
}

// ---------------------------------------------------------------------
//  Schermata fissa
// ---------------------------------------------------------------------
static void drawStaticPage()
{
    printCentered(LINE2_Y, 1, C_TXT,  C_BG, "High-quality embedded");
    printCentered(LINE3_Y, 1, C_TXT,  C_BG, "board production");
    printCentered(LINE4_Y, 1, C_GREEN, C_BG, "www.pcbway.com");
}

// ---------------------------------------------------------------------
//  Scintille: solo sui pixel "vuoti" del logo, cosi' cancellarle a nero
//  non buca mai il marchio.
// ---------------------------------------------------------------------
static constexpr uint8_t N_SPARKS = 7;
static int16_t sparkX[N_SPARKS], sparkY[N_SPARKS];

static void sparkleStep()
{
    for (uint8_t i = 0; i < N_SPARKS; ++i)
        if (sparkX[i] >= 0)
            tft.drawPixel(sparkX[i], sparkY[i], C_BG);

    for (uint8_t i = 0; i < N_SPARKS; ++i) {
        sparkX[i] = -1;
        for (uint8_t attempt = 0; attempt < 10; ++attempt) {
            const int16_t rx = random(PCBWAY_W);
            const int16_t ry = random(PCBWAY_H);
            if (!bmpBit(PCBWAY_GREEN, rx, ry) && !bmpBit(PCBWAY_ORANGE, rx, ry)) {
                sparkX[i] = LOGO_X + rx;
                sparkY[i] = LOGO_Y + ry;
                break;
            }
        }
        if (sparkX[i] >= 0)
            tft.drawPixel(sparkX[i], sparkY[i],
                          random(3) ? C_TXT : C_ORANGE);
    }
}

// ---------------------------------------------------------------------
//  Striscia scorrevole: disegnata su canvas 1bpp e riversata in un colpo,
//  quindi scorre liscia senza sfarfallio.
// ---------------------------------------------------------------------
static int16_t  scrollX  = 160;
static int16_t  msgPx    = 0;

static void marqueeStep()
{
    marquee.fillScreen(0);
    marquee.setTextWrap(false);
    marquee.setTextSize(1);
    marquee.setTextColor(1);

    marquee.setCursor(scrollX, 2);
    marquee.print(MARQUEE_MSG);
    marquee.setCursor(scrollX + msgPx, 2);        // seconda copia: loop infinito
    marquee.print(MARQUEE_MSG);

    tft.drawBitmap(0, MARQ_Y, marquee.getBuffer(), 160, MARQ_H, C_TXT, C_GREEN);

    if (--scrollX <= -msgPx)
        scrollX = 0;
}

// =====================================================================
void setup()
{
    Serial.begin(115200);
    delay(50);
    Serial.println(F("\n=== Proud to announce a new sponsorship by PCBWay! ==="));
    Serial.println(F("High quality embedded board production"));
    Serial.println(F("Order here: https://www.pcbway.com/"));

    randomSeed(micros());
    for (uint8_t i = 0; i < N_SPARKS; ++i) sparkX[i] = -1;
    msgPx = (int16_t)strlen(MARQUEE_MSG) * 6;

    lcdBegin();

    introTeaser();
    introDrop();
    introRouteSwoosh();
    introFlash();
    drawStaticPage();
}

void loop()
{
    static uint32_t tMarq = 0, tSpark = 0, tBlink = 0;
    static uint8_t  phase = 0;

    const uint32_t now = millis();

    if (now - tMarq >= 28) {                 // ~35 fps di scroll
        tMarq = now;
        marqueeStep();
    }

    if (now - tSpark >= 180) {
        tSpark = now;
        sparkleStep();
    }

    if (now - tBlink >= 450) {
        tBlink = now;
        phase++;

        // titolo che cambia colore
        static const uint16_t cycle[3] = { C_ORANGE, C_GREEN, C_TXT };
        printCentered(LINE1_Y, 1, cycle[phase % 3], C_BG, "NEW SPONSOR!");

        // call to action lampeggiante
        if (phase & 1)
            printCentered(LINE5_Y, 1, C_BG, C_BG, ">> ORDER HERE <<");
        else
            printCentered(LINE5_Y, 1, C_ORANGE, C_BG, ">> ORDER HERE <<");
    }
}